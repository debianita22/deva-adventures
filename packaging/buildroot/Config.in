## packaging/buildroot/package/deva-adventures/Config.in
```kconfig
config BR2_PACKAGE_DEVA_ADVENTURES
	bool "deva-adventures"
	depends on BR2_TOOLCHAIN_HAS_THREADS # saves flushed in a helper thread (0.15)
	help
	  Deva's Awesome Adventures: educational libretro core for
	  5-year-olds (Italian voice). Contentless: RetroArch lists it
	  under "Contentless Cores". Installs the core, its .info file
	  and the game data in /usr/share/deva_adventures (about
	  16.5 MB).

if BR2_PACKAGE_DEVA_ADVENTURES

config BR2_PACKAGE_DEVA_ADVENTURES_SRC
	string "path to the deva-adventures source tree"
	default "$(BR2_EXTERNAL_DEVA_ADVENTURES_PATH)/../.."
	help
	  The source tree to build from. By default the one this
	  br2-external tree belongs to (packaging/buildroot is two
	  levels below it).

config BR2_PACKAGE_DEVA_ADVENTURES_CORE_DIR
	string "libretro cores directory on the target"
	default "/usr/lib/libretro"

config BR2_PACKAGE_DEVA_ADVENTURES_INFO_DIR
	string "libretro info directory on the target"
	default "/usr/share/libretro/info"

endif

comment "deva-adventures needs a toolchain w/ threads"
	depends on !BR2_TOOLCHAIN_HAS_THREADS
```
